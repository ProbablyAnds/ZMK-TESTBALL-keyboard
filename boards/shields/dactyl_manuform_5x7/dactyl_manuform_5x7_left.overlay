#include "dactyl_manuform_5x7.dtsi"

&kscan0 {
    row-gpios
        = <&gpio0  09 (GPIO_ACTIVE_HIGH | GPIO_PULL_DOWN)>,
          <&gpio0  10 (GPIO_ACTIVE_HIGH | GPIO_PULL_DOWN)>,
          <&gpio1  11 (GPIO_ACTIVE_HIGH | GPIO_PULL_DOWN)>,
          <&gpio1  13 (GPIO_ACTIVE_HIGH | GPIO_PULL_DOWN)>,
          <&gpio1  15 (GPIO_ACTIVE_HIGH | GPIO_PULL_DOWN)>;

    col-gpios
        = <&gpio1 06 GPIO_ACTIVE_HIGH>,
          <&gpio1 04 GPIO_ACTIVE_HIGH>,
          <&gpio0 11 GPIO_ACTIVE_HIGH>,
          <&gpio1 00 GPIO_ACTIVE_HIGH>,
          <&gpio0 24 GPIO_ACTIVE_HIGH>,
          <&gpio0 22 GPIO_ACTIVE_HIGH>,
          <&gpio0 20 GPIO_ACTIVE_HIGH>;
};
